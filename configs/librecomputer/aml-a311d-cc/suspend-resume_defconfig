## configs/librecomputer/aml-a311d-cc/suspend-resume_defconfig
```kconfig
BR2_aarch64=y
BR2_cortex_a73_a53=y
BR2_TOOLCHAIN_EXTERNAL=y
BR2_TOOLCHAIN_EXTERNAL_BOOTLIN=y
BR2_TOOLCHAIN_EXTERNAL_BOOTLIN_AARCH64_GLIBC_STABLE=y
BR2_CCACHE=y
BR2_ENABLE_LTO=y
BR2_ROOTFS_DEVICE_CREATION_DYNAMIC_EUDEV=y
BR2_ROOTFS_MERGED_USR=y
BR2_SYSTEM_DHCP="eth0"
BR2_SYSTEM_DEFAULT_PATH="/bin:/sbin:/usr/bin:/usr/sbin"
BR2_ROOTFS_OVERLAY="board/librecomputer/overlay/suspend-resume board/librecomputer/overlay/debugfs"
BR2_ROOTFS_POST_IMAGE_SCRIPT="board/librecomputer/genimage/initramfs/genimage.sh"
BR2_ROOTFS_POST_SCRIPT_ARGS="aml-a311d-cc board/librecomputer/project/suspend-resume/aml-a311d-cc"
BR2_LINUX_KERNEL=y
BR2_LINUX_KERNEL_CUSTOM_TARBALL=y
BR2_LINUX_KERNEL_CUSTOM_TARBALL_LOCATION="https://github.com/libre-computer-project/libretech-linux/archive/refs/heads/linux-6.12.y-lc.tar.gz"
BR2_LINUX_KERNEL_USE_CUSTOM_CONFIG=y
BR2_LINUX_KERNEL_CUSTOM_CONFIG_FILE="board/librecomputer/project/suspend-resume/linux_defconfig"
BR2_LINUX_KERNEL_LZ4=y
BR2_LINUX_KERNEL_NEEDS_HOST_PAHOLE=y
BR2_PACKAGE_LINUX_TOOLS_CPUPOWER=y
BR2_PACKAGE_LINUX_TOOLS_GPIO=y
BR2_PACKAGE_STRACE=y
BR2_PACKAGE_BTRFS_PROGS=y
BR2_PACKAGE_ETHTOOL=y
BR2_TARGET_ROOTFS_CPIO_LZ4=y
BR2_TARGET_ROOTFS_INITRAMFS=y
# BR2_TARGET_ROOTFS_TAR is not set
BR2_PACKAGE_HOST_DOSFSTOOLS=y
BR2_PACKAGE_HOST_GENIMAGE=y
BR2_PACKAGE_HOST_MTOOLS=y
BR2_PACKAGE_HOST_UBOOT_TOOLS=y
BR2_PACKAGE_HOST_UTIL_LINUX=y
```
